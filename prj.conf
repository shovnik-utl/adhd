## CMakeLists.txt
```
# SPDX-License-Identifier: Apache-2.0

cmake_minimum_required(VERSION 3.20.0)
set(mcuboot_CONFIG_BOOT_SIGNATURE_KEY_FILE \"${CMAKE_CURRENT_SOURCE_DIR}/priv.pem\")
find_package(Zephyr REQUIRED HINTS $ENV{ZEPHYR_BASE})
project(adhd)

target_sources(app PRIVATE
  src/main.c
  src/battery.c
  src/haptics.c
)
```

## prj.conf
```kconfig
# Increased stack due to settings API usage
CONFIG_SYSTEM_WORKQUEUE_STACK_SIZE=2048

CONFIG_BT=y
CONFIG_LOG=y
CONFIG_BT_SMP=y
CONFIG_BT_SIGNING=y
CONFIG_BT_PERIPHERAL=y

CONFIG_BT_ATT_PREPARE_COUNT=5
CONFIG_BT_BAS=y
CONFIG_BT_PRIVACY=y
CONFIG_BT_DEVICE_NAME="ADHD"
CONFIG_BT_DEVICE_APPEARANCE=833
CONFIG_BT_DEVICE_NAME_DYNAMIC=n

CONFIG_BT_KEYS_OVERWRITE_OLDEST=y
CONFIG_BT_SETTINGS=y
CONFIG_FLASH=y
CONFIG_FLASH_PAGE_LAYOUT=y
CONFIG_FLASH_MAP=y
CONFIG_NVS=y
CONFIG_SETTINGS=y

# Device Information Service (DIS) for exposing device info.
CONFIG_SETTINGS_RUNTIME=y
CONFIG_BT_DIS=y
CONFIG_BT_DIS_SETTINGS=y
CONFIG_BT_DIS_STR_MAX=21
CONFIG_BT_DIS_PNP=n
CONFIG_BT_DIS_MODEL="ADHD"
CONFIG_BT_DIS_MANUF="Minew"
CONFIG_BT_DIS_SERIAL_NUMBER=n
CONFIG_BT_DIS_FW_REV=y
CONFIG_BT_DIS_FW_REV_STR=""
CONFIG_BT_DIS_HW_REV=y
CONFIG_BT_DIS_HW_REV_STR="MS135F6_V1.0"

# Enable MCUBoot bootloader for DFU over BLE (FOTA).
CONFIG_BOOTLOADER_MCUBOOT=y
CONFIG_NCS_SAMPLE_MCUMGR_BT_OTA_DFU=y

# Disable asserts.
CONFIG_ASSERT=n
```

## boards/nrf52dk_nrf52832.overlay
```dts
/ {
	haptics { /* Transistor gated motor for haptic response to button presses. */
		compatible = "gpio-leds";
		vibm: vibration_motor {
			gpios = <&gpio0 02 GPIO_ACTIVE_HIGH>; /* P0.02 */
			label = "Vibration Motor";
		};
	};
};
```

## src/main.c
```c
/* Demo BLE Battery GATT Service. */
#include <zephyr/types.h>
#include <stddef.h>
#include <string.h>
#include <errno.h>

#include <zephyr/sys/byteorder.h>
#include <zephyr/kernel.h>
#include <zephyr/settings/settings.h>

#include <zephyr/bluetooth/bluetooth.h>
#include <zephyr/bluetooth/conn.h>
#include <zephyr/bluetooth/uuid.h>

#include <zephyr/logging/log.h>
LOG_MODULE_REGISTER(adhd_main, LOG_LEVEL_DBG);

#include "app_version.h"
#include "battery.h"
#include "haptics.h"

/* Connection state management. */
static volatile bool ble_connected	= false;
static volatile bool alarm_started	= false;

/* Battery service periodic update interval. */
static const k_timeout_t BAS_UPDATE_INTERVAL = K_SECONDS(1);

/* BLE advertisement params (for GAP). */
static const struct bt_data ad[] = {
	BT_DATA_BYTES(BT_DATA_FLAGS, (BT_LE_AD_GENERAL | BT_LE_AD_NO_BREDR)),
	BT_DATA_BYTES(BT_DATA_UUID16_ALL,
		      BT_UUID_16_ENCODE(BT_UUID_BAS_VAL))
};

/* Callbacks for connection/disconnection status (GAP). */
static void connected(struct bt_conn *conn, uint8_t err)
{
	if (err) {
		LOG_INF("Connection failed (err 0x%02x).", err);
	}
	else {
		ble_connected = true;
		LOG_INF("Connected.");
	}
}

static void disconnected(struct bt_conn *conn, uint8_t reason)
{
	ble_connected = false;
	LOG_INF("Disconnected (reason 0x%02x).", reason);
	bt_unpair(BT_ID_DEFAULT, BT_ADDR_LE_ANY); /* Clear pairing info for next time pairing. */
}

BT_CONN_CB_DEFINE(conn_callbacks) = {
	.connected = connected,
	.disconnected = disconnected,
};

/* Callbacks for pairing (SMP). */
static void auth_cancel(struct bt_conn *conn)
{
	char addr[BT_ADDR_LE_STR_LEN];

	bt_addr_le_to_str(bt_conn_get_dst(conn), addr, sizeof(addr));

	LOG_INF("Pairing cancelled: %s", addr);
}

static struct bt_conn_auth_cb auth_cb_display = {
	.passkey_display = NULL,
	.passkey_entry = NULL,
	.cancel = auth_cancel,
	.passkey_confirm = NULL
};

/* Runtime settings override. */
static void settings_runtime_load(void)
{
#if defined(CONFIG_BT_DIS_FW_REV)
	settings_runtime_set("bt/dis/fw", APP_VERSION_STRING, sizeof(APP_VERSION_STRING));
#endif
}

/* Initialize the BLE stack and start advertising. */
static int bt_ready(void)
{
	/* Register SMP callbacks for pairing. */
	bt_conn_auth_cb_register(&auth_cb_display);

	/* Initialize BLE stack and signal ready when done. */
	int err = bt_enable(NULL);
	if (err) {
		LOG_INF("Bluetooth init failed (err %d).", err);
		return 1;
	}
	LOG_INF("Bluetooth initialized.");

	/* Load BLE settings. */
	if (IS_ENABLED(CONFIG_SETTINGS)) {
		settings_load();
	}
	settings_runtime_load();

	/* Start BLE advertising. */
	err = bt_le_adv_start(BT_LE_ADV_CONN_NAME, ad, ARRAY_SIZE(ad), NULL, 0);
	if (err) {
		LOG_INF("Advertising failed to start (err %d).", err);
		return 2;
	}
	LOG_INF("Advertising successfully started.");
	
	return 0; 
}

int main(void)
{
	/* Initialize peripherals. */
	gpio_init_haptics();

	/* Run BLE initialization routines. */
	if (bt_ready())
		return 1;

	/* Start periodic battery service function. */
	bas_start(BAS_UPDATE_INTERVAL);

	/* Application super loop. */
	while (true)
	{
		if (!ble_connected && !alarm_started) {
			alarm_started = true;
			haptic_response(alarm_started);
			
		}
		else if (alarm_started && ble_connected) {
			alarm_started = false;
			haptic_response(alarm_started);
		}
		k_msleep(10);
	}
	return 0;
}
```

## src/battery.c
```c
#include <zephyr/kernel.h>
#include <zephyr/bluetooth/services/bas.h>

#include <zephyr/logging/log.h>
LOG_MODULE_REGISTER(adhd_battery, LOG_LEVEL_DBG);

#include "battery.h"

/* Notify the client about battery level via BAS (Battery Service). */
static void bas_notify(struct k_work *work)
{
    (void)work;
	uint8_t battery_level = bt_bas_get_battery_level();
	/* Fake battery status, ie a simulation: decrement from 100 down to 0 and reset. 
	   In actual practice, you would have some kind of a battery_measure()
	   function call here which queries your battery status by reading an ADC
	   and doing calculations with reference to your battery's discharge curve!
	   Refer to https://github.com/zephyrproject-rtos/zephyr/tree/main/samples/boards/nrf/battery
	*/
	battery_level--;
	if (!battery_level) {
		battery_level = 100U;
	}
	bt_bas_set_battery_level(battery_level);
}

/* For non-trivial work, its best to submit a work item to the system work queue
   from the timer expiry callback, instead of doing it within the callback 
   itself. */
K_WORK_DEFINE(bas_work, bas_notify);

static void bas_timer_expiry_fn(struct k_timer *timer_id)
{
    (void)timer_id;
    k_work_submit(&bas_work);
}

K_TIMER_DEFINE(bas_timer, bas_timer_expiry_fn, NULL);

void bas_start(k_timeout_t bas_update_interval)
{
    /* Start periodic timer. */
    k_timer_start(&bas_timer, bas_update_interval, bas_update_interval);
}
```

## src/battery.h
```c
#ifndef ADHD_BATTERY_H
#define ADHD_BATTERY_H

void bas_start(k_timeout_t bas_update_interval);

#endif
```

## src/haptics.c
```c
#include <zephyr/kernel.h>
#include <zephyr/devicetree.h>
#include <zephyr/drivers/gpio.h>

#include <zephyr/logging/log.h>
LOG_MODULE_REGISTER(adhd_haptics, LOG_LEVEL_DBG);

#include "haptics.h"

/* Get GPIO pin attached to vibration motor on the device. */
#define VIBRATION_MOTOR_NODE DT_NODELABEL(vibm)
static const struct gpio_dt_spec haptics = GPIO_DT_SPEC_GET(VIBRATION_MOTOR_NODE, gpios);

/* Binary semaphore for controlling haptic response thread. */
static K_SEM_DEFINE(sem_haptics, 0, 1);

/* Thread for doing haptic response continuously. */
#define HAPTIC_RESPONSE_THREAD_PRIORITY 5
#define HAPTIC_RESPONSE_THREAD_STACKSIZE 1024
K_THREAD_STACK_DEFINE(haptic_response_thread_stack_area, HAPTIC_RESPONSE_THREAD_STACKSIZE);
struct k_thread haptic_response_thread_data;

static void vibrate()
{
    for (;;) {
        gpio_pin_set_dt(&haptics, 1);
        k_msleep(100);
        gpio_pin_set_dt(&haptics, 0);
        if (0 == k_sem_take(&sem_haptics, K_NO_WAIT)) {
            /* Signal to stop haptic response. */
            gpio_pin_set_dt(&haptics, 0);
            break;
        }
        k_msleep(500);
    }
}

void haptic_response(bool start)
{
    if (start) {
        k_thread_create(
            &haptic_response_thread_data, haptic_response_thread_stack_area,
            K_THREAD_STACK_SIZEOF(haptic_response_thread_stack_area),
            vibrate, NULL, NULL, NULL,
            HAPTIC_RESPONSE_THREAD_STACKSIZE, 0, K_NO_WAIT
        );
    }
    else {
        k_sem_give(&sem_haptics);
    }
}

int gpio_init_haptics(void)
{
	int ret;
	if (gpio_is_ready_dt(&haptics)) {
		ret = gpio_pin_configure_dt(&haptics, GPIO_OUTPUT_ACTIVE);
		if (ret == 0) {
			gpio_pin_set_dt(&haptics, 0); /* Motor is off initially. */
			LOG_INF("Vibration motor initialized @%s pin %d.", haptics.port->name, haptics.pin);
			return 0;
		}
	}
	LOG_ERR("Vibration motor initialization failed.");
	return 1;
}
```

## src/haptics.h
```c
#ifndef ADHD_HAPTICS_H
#define ADHD_HAPTICS_H

int gpio_init_haptics(void);
void haptic_response(bool start);

#endif
```
